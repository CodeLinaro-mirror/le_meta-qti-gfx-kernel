## conf/layer.conf
```bitbake
BBPATH .= ":${LAYERDIR}"

BBFILE_COLLECTIONS          += "qti-gfx-kernel"
BBFILE_PRIORITY_qti-gfx-kernel = "17"
BBFILE_PATTERN_qti-gfx-kernel := "^${LAYERDIR}/"

LAYERSERIES_COMPAT_qti-gfx-kernel = "kirkstone"

BBFILES += "${LAYERDIR}/recipes/*/*.bb \
            ${LAYERDIR}/recipes/*/*.bbappend \
            ${LAYERDIR}/recipes-products/images/*.bbappend"

LAYERDEPENDS_qti-gfx-kernel = "core qti-bsp"
LAYERVERSION_qti-gfx-kernel = "1"
```
